## drivers/media/platform/wmt/Kconfig
```kconfig
# SPDX-License-Identifier: GPL-2.0-only

comment "WonderMedia media platform drivers"

config VIDEO_WMT_JDEC
	tristate "WonderMedia WM8505 JPEG decoder"
	depends on V4L_MEM2MEM_DRIVERS
	depends on VIDEO_DEV
	depends on ARCH_VT8500 || COMPILE_TEST
	select VIDEOBUF2_DMA_CONTIG
	select V4L2_MEM2MEM_DEV
	select V4L2_JPEG_HELPER
	help
	  This is a V4L2 memory-to-memory driver for the WonderMedia WM8505
	  JPEG decoder hardware block. It provides hardware-accelerated baseline
	  JPEG and Motion JPEG decoding.

	  Say M here if you want to enable support for the WM8505 JPEG decoder.

	  The module will be called wmt-jdec.

config VIDEO_WMT_SCL
	tristate "WonderMedia WM8505 scaler"
	depends on V4L_MEM2MEM_DRIVERS
	depends on VIDEO_DEV
	depends on ARCH_VT8500 || COMPILE_TEST
	select VIDEOBUF2_DMA_CONTIG
	select V4L2_MEM2MEM_DEV
	select MFD_SYSCON
	help
	  This is a V4L2 memory-to-memory driver for the WonderMedia WM8505
	  picture scaler and color space converter. It supports bilinear
	  upscaling, box-filter downscaling, and format conversion between
	  NV12 and ARGB8888.

	  Say M here if you want to enable support for the WM8505 scaler.

	  The module will be called wmt-scl.
```

## sound/soc/wmt/Kconfig
```kconfig
# SPDX-License-Identifier: GPL-2.0-only
menuconfig SND_SOC_WMT
	tristate "ASoC support for WonderMedia"
	depends on ARCH_VT8500 || COMPILE_TEST
	help
	  Say Y or M if you want to add support for SoC audio on
	  WonderMedia platforms. This allows selecting drivers
	  for the built-in audio controllers.
	  If unsure, say N.

if SND_SOC_WMT

config SND_SOC_WM8505_AC97
	tristate "WM8505 AC97 Audio support"
	select AC97_BUS
	select MFD_SYSCON
	select SND_AC97_CODEC
	select SND_SOC_AC97_BUS
	select SND_SOC_AC97_CODEC
	select SND_SOC_GENERIC_DMAENGINE_PCM
	help
	  Say Y or M if you want to enable support for the AC97
	  audio controller found on the WonderMedia WM8505 SoC.
	  This will provide audio playback and capture support
	  for this platform. If unsure, say N.

endif # SND_SOC_WMT
```
