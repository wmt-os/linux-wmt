## Documentation/devicetree/bindings/arm/wm,wm8505.yaml
```yaml
# SPDX-License-Identifier: (GPL-2.0-only OR BSD-2-Clause)
%YAML 1.2
---
$id: http://devicetree.org/schemas/arm/wm,wm8505.yaml#
$schema: http://devicetree.org/meta-schemas/core.yaml#

title: WonderMedia WM8505 Platforms

maintainers:
  - Logan Russell <me@lrussell.net>

properties:
  $nodename:
    const: "/"
  compatible:
    items:
      - enum:
          - wm,wm8505-ref
      - const: wm,wm8505

additionalProperties: true
...
```

## Documentation/devicetree/bindings/clock/wm,wm8505-pmc.yaml
```yaml
# SPDX-License-Identifier: (GPL-2.0-only OR BSD-2-Clause)
%YAML 1.2
---
$id: http://devicetree.org/schemas/clock/wm,wm8505-pmc.yaml#
$schema: http://devicetree.org/meta-schemas/core.yaml#

title: WonderMedia WM8505 Clock Controller (PMC)

maintainers:
  - Logan Russell <me@lrussell.net>

properties:
  compatible:
    const: wm,wm8505-pmc

  reg:
    maxItems: 1

  clocks:
    items:
      - description: Main 24 MHz oscillator
      - description: Main 25 MHz oscillator

  clock-names:
    items:
      - const: osc24m
      - const: osc25m

  "#clock-cells":
    const: 1
    description: The clock index matching the constants in <dt-bindings/clock/wm8505-clock.h>

required:
  - compatible
  - reg
  - clocks
  - clock-names
  - "#clock-cells"

additionalProperties: false

examples:
  - |
    clock-controller@d8130000 {
        compatible = "wm,wm8505-pmc";
        reg = <0xd8130000 0x1000>;
        #clock-cells = <1>;
        clocks = <&osc24m>, <&osc25m>;
        clock-names = "osc24m", "osc25m";
    };
```

## Documentation/devicetree/bindings/display/panel/wm,wm8505-panel.yaml
```yaml
# SPDX-License-Identifier: (GPL-2.0-only OR BSD-2-Clause)
%YAML 1.2
---
$id: http://devicetree.org/schemas/display/panel/wm,wm8505-panel.yaml#
$schema: http://devicetree.org/meta-schemas/core.yaml#

title: WonderMedia WM8505 Netbook Panel

maintainers:
  - Logan Russell <me@lrussell.net>

description:
  The DPI panel fitted to a WM8505 netbook varies by model. The panel-timing
  node carries the reference design timings; the bootloader may supply the
  fitted panel's own.

select:
  properties:
    compatible:
      contains:
        const: wm,wm8505-panel
  required:
    - compatible

allOf:
  - $ref: panel-common.yaml#

properties:
  compatible:
    items:
      - const: wm,wm8505-panel
      - const: panel-dpi

required:
  - compatible
  - width-mm
  - height-mm
  - panel-timing
  - power-supply
  - port

unevaluatedProperties: false

examples:
  - |
    panel {
        compatible = "wm,wm8505-panel", "panel-dpi";
        power-supply = <&vcc33>;
        backlight = <&backlight>;
        width-mm = <154>;
        height-mm = <86>;

        port {
            panel_in: endpoint {
                remote-endpoint = <&display_out>;
            };
        };

        panel-timing {
            clock-frequency = <30000000>;
            hactive = <800>;
            vactive = <480>;
            hsync-len = <48>;
            hback-porch = <40>;
            hfront-porch = <40>;
            vsync-len = <3>;
            vback-porch = <29>;
            vfront-porch = <13>;
        };
    };
```

## Documentation/devicetree/bindings/display/wm,wm8505-drm.yaml
```yaml
# SPDX-License-Identifier: (GPL-2.0-only OR BSD-2-Clause)
%YAML 1.2
---
$id: http://devicetree.org/schemas/display/wm,wm8505-drm.yaml#
$schema: http://devicetree.org/meta-schemas/core.yaml#

title: WonderMedia WM8505 DRM/KMS Display Controller

maintainers:
  - Logan Russell <me@lrussell.net>

properties:
  compatible:
    const: wm,wm8505-drm

  reg:
    items:
      - description: Graphics Output (GOVRH) registers
      - description: Video DMA (VDMA) registers

  reg-names:
    items:
      - const: govrh
      - const: vdma

  interrupts:
    items:
      - description: VPP vertical blanking interrupt
      - description: VDMA transfer completion interrupt

  interrupt-names:
    items:
      - const: vpp
      - const: vdma

  clocks:
    maxItems: 5

  clock-names:
    items:
      - const: dvo
      - const: govrh
      - const: vpp
      - const: vdma
      - const: ge

  wm,ge:
    $ref: /schemas/types.yaml#/definitions/phandle
    description: Phandle to the 2D Graphics Engine (GE) node

  wm,vpp:
    $ref: /schemas/types.yaml#/definitions/phandle
    description: Phandle to the Video Post Processor (VPP) syscon node

  port:
    $ref: /schemas/graph.yaml#/properties/port
    description: Output port endpoint for the display panel

required:
  - compatible
  - reg
  - reg-names
  - interrupts
  - interrupt-names
  - clocks
  - clock-names
  - wm,ge
  - wm,vpp

additionalProperties: false

examples:
  - |
    #include <dt-bindings/clock/wm8505-clock.h>

    display@d8050800 {
        compatible = "wm,wm8505-drm";
        reg = <0xd8050800 0x200>, <0xd8001c00 0x100>;
        reg-names = "govrh", "vdma";
        interrupts-extended = <&intc1 16>, <&intc0 9>;
        interrupt-names = "vpp", "vdma";
        clocks = <&pmc WM8505_CLK_DVO>,
                 <&pmc WM8505_CLK_GOVRHD>,
                 <&pmc WM8505_CLK_VPP>,
                 <&pmc WM8505_CLK_PDMA>,
                 <&pmc WM8505_CLK_GE>;
        clock-names = "dvo", "govrh", "vpp", "vdma", "ge";
        wm,ge = <&graphics>;
        wm,vpp = <&vpp>;

        port {
            display_out: endpoint {
                remote-endpoint = <&panel_in>;
            };
        };
    };
```

## Documentation/devicetree/bindings/dma/wm,wm8505-dma.yaml
```yaml
# SPDX-License-Identifier: (GPL-2.0-only OR BSD-2-Clause)
%YAML 1.2
---
$id: http://devicetree.org/schemas/dma/wm,wm8505-dma.yaml#
$schema: http://devicetree.org/meta-schemas/core.yaml#

title: WonderMedia WM8505 DMA Controller

maintainers:
  - Logan Russell <me@lrussell.net>

properties:
  compatible:
    const: wm,wm8505-dma

  reg:
    maxItems: 1

  interrupts:
    minItems: 16
    maxItems: 16
    description: Individual interrupt lines for each of the 16 DMA channels

  clocks:
    maxItems: 1

  "#dma-cells":
    const: 1
    description: Contains the request ID/channel number for the connecting peripheral

required:
  - compatible
  - reg
  - interrupts
  - clocks
  - "#dma-cells"

additionalProperties: false

examples:
  - |
    #include <dt-bindings/clock/wm8505-clock.h>

    dma-controller@d8001800 {
        compatible = "wm,wm8505-dma";
        reg = <0xd8001800 0x400>;
        interrupts = <17>, <27>, <34>, <40>,
                     <41>, <45>, <46>, <51>,
                     <28>, <29>, <30>, <31>,
                     <32>, <33>, <34>, <35>;
        clocks = <&pmc WM8505_CLK_DMA>;
        #dma-cells = <1>;
    };
```

## Documentation/devicetree/bindings/input/wm,wm8505-ps2.yaml
```yaml
# SPDX-License-Identifier: (GPL-2.0-only OR BSD-2-Clause)
%YAML 1.2
---
$id: http://devicetree.org/schemas/input/wm,wm8505-ps2.yaml#
$schema: http://devicetree.org/meta-schemas/core.yaml#

title: WonderMedia WM8505 PS/2 Controller

maintainers:
  - Logan Russell <me@lrussell.net>

properties:
  compatible:
    const: wm,wm8505-ps2

  reg:
    maxItems: 1

  interrupts:
    items:
      - description: Keyboard (KBD) interrupt
      - description: Auxiliary (AUX/Touchpad) interrupt

  interrupt-names:
    items:
      - const: kbd
      - const: aux

  clocks:
    maxItems: 1

required:
  - compatible
  - reg
  - interrupts
  - interrupt-names
  - clocks

additionalProperties: false

examples:
  - |
    #include <dt-bindings/clock/wm8505-clock.h>

    ps2@d8008800 {
        compatible = "wm,wm8505-ps2";
        reg = <0xd8008800 0x100>;
        interrupts = <23>, <4>;
        interrupt-names = "kbd", "aux";
        clocks = <&pmc WM8505_CLK_PS2KBDC>;
    };
```

## Documentation/devicetree/bindings/media/wm,wm8505-jdec.yaml
```yaml
# SPDX-License-Identifier: (GPL-2.0-only OR BSD-2-Clause)
%YAML 1.2
---
$id: http://devicetree.org/schemas/media/wm,wm8505-jdec.yaml#
$schema: http://devicetree.org/meta-schemas/core.yaml#

title: WonderMedia WM8505 JPEG Decoder

maintainers:
  - Logan Russell <me@lrussell.net>

description:
  Memory-to-memory baseline JPEG and Motion JPEG decoder.

properties:
  compatible:
    const: wm,wm8505-jdec

  reg:
    maxItems: 1

  interrupts:
    maxItems: 1

  clocks:
    maxItems: 1

required:
  - compatible
  - reg
  - interrupts
  - clocks

additionalProperties: false

examples:
  - |
    #include <dt-bindings/clock/wm8505-clock.h>

    jpeg-decoder@d80fe000 {
        compatible = "wm,wm8505-jdec";
        reg = <0xd80fe000 0x1000>;
        interrupt-parent = <&intc1>;
        interrupts = <1>;
        clocks = <&pmc WM8505_CLK_JENC>;
    };
```

## Documentation/devicetree/bindings/media/wm,wm8505-scl.yaml
```yaml
# SPDX-License-Identifier: (GPL-2.0-only OR BSD-2-Clause)
%YAML 1.2
---
$id: http://devicetree.org/schemas/media/wm,wm8505-scl.yaml#
$schema: http://devicetree.org/meta-schemas/core.yaml#

title: WonderMedia WM8505 Scaler

maintainers:
  - Logan Russell <me@lrussell.net>

description:
  Memory-to-memory picture scaler and color space converter. Its interrupt
  and reset lines live in the shared Video Post Processor (VPP) register
  block, so the interrupt line is shared with the display controller.

properties:
  compatible:
    const: wm,wm8505-scl

  reg:
    maxItems: 1

  interrupts:
    maxItems: 1
    description: Shared VPP interrupt

  clocks:
    maxItems: 1

  wm,vpp:
    $ref: /schemas/types.yaml#/definitions/phandle
    description: Phandle to the VPP syscon node

required:
  - compatible
  - reg
  - interrupts
  - clocks
  - wm,vpp

additionalProperties: false

examples:
  - |
    #include <dt-bindings/clock/wm8505-clock.h>

    scaler@d8050d00 {
        compatible = "wm,wm8505-scl";
        reg = <0xd8050d00 0x100>;
        interrupt-parent = <&intc1>;
        interrupts = <16>;
        clocks = <&pmc WM8505_CLK_SCL444U>;
        wm,vpp = <&vpp>;
    };
```

## Documentation/devicetree/bindings/mtd/wm,wm8505-sf.yaml
```yaml
# SPDX-License-Identifier: (GPL-2.0-only OR BSD-2-Clause)
%YAML 1.2
---
$id: http://devicetree.org/schemas/mtd/wm,wm8505-sf.yaml#
$schema: http://devicetree.org/meta-schemas/core.yaml#

title: WonderMedia Serial Flash Controller (SFC)

maintainers:
  - Logan Russell <me@lrussell.net>

allOf:
  - $ref: mtd.yaml#

properties:
  compatible:
    const: wm,wm8505-sf

  reg:
    maxItems: 1

  clocks:
    maxItems: 1

required:
  - compatible
  - reg
  - clocks

unevaluatedProperties: false

examples:
  - |
    #include <dt-bindings/clock/wm8505-clock.h>

    flash@d800c000 {
        compatible = "wm,wm8505-sf";
        reg = <0xd800c000 0x400>;
        clocks = <&pmc WM8505_CLK_SFC>;

        partitions {
            compatible = "fixed-partitions";
            #address-cells = <1>;
            #size-cells = <1>;

            partition@0 {
                label = "u-boot";
                reg = <0x0 0x80000>;
            };
        };
    };
```

## Documentation/devicetree/bindings/power/supply/wm,wm8505-battery.yaml
```yaml
# SPDX-License-Identifier: (GPL-2.0-only OR BSD-2-Clause)
%YAML 1.2
---
$id: http://devicetree.org/schemas/power/supply/wm,wm8505-battery.yaml#
$schema: http://devicetree.org/meta-schemas/core.yaml#

title: WonderMedia WM8505 Battery Monitor

maintainers:
  - Logan Russell <me@lrussell.net>

description:
  The WM8505 netbook has no ADC and measures its battery voltage by timing
  how long an RC network charged from the battery rail takes to pull a GPIO
  past its input threshold.

allOf:
  - $ref: power-supply.yaml#

properties:
  compatible:
    const: wm,wm8505-battery

  sense-gpios:
    maxItems: 1
    description: GPIO wired to the RC measurement network

  charge-done-gpios:
    maxItems: 1
    description:
      GPIO driven by the on-board charging circuit to report charge
      completion. The completed level varies across the population.

  low-battery-gpios:
    maxItems: 1
    description: GPIO asserted by the low-voltage comparator

  revision-gpios:
    maxItems: 1
    description:
      Unused pad strapped per charging-circuit revision, high where the
      charge-done output completes at 0 and low where it completes at 1

  wm,threshold-microvolt:
    minimum: 1
    description:
      Input threshold of the sense GPIO, referred to the battery rail by the
      on-board resistor divider

  wm,alarm-microvolt:
    description:
      Battery voltage at which the low-voltage comparator trips, one cell per
      charging-circuit revision
    items:
      - description: Trip voltage where charge-done reads 0 when complete
      - description: Trip voltage where charge-done reads 1 when complete

  monitored-battery: true

required:
  - compatible
  - sense-gpios
  - charge-done-gpios
  - low-battery-gpios
  - revision-gpios
  - wm,threshold-microvolt
  - wm,alarm-microvolt
  - monitored-battery
  - power-supplies

unevaluatedProperties: false

examples:
  - |
    #include <dt-bindings/gpio/gpio.h>

    battery-monitor {
        compatible = "wm,wm8505-battery";
        sense-gpios = <&pinctrl 4 GPIO_ACTIVE_HIGH>;
        charge-done-gpios = <&pinctrl 1 GPIO_ACTIVE_HIGH>;
        low-battery-gpios = <&pinctrl 259 GPIO_ACTIVE_LOW>;
        revision-gpios = <&pinctrl 19 GPIO_ACTIVE_HIGH>;
        monitored-battery = <&battery>;
        power-supplies = <&charger>;
        wm,threshold-microvolt = <4000000>;
        wm,alarm-microvolt = <6870000 6780000>;
    };
```

## Documentation/devicetree/bindings/sound/wm,wm8505-ac97.yaml
```yaml
# SPDX-License-Identifier: (GPL-2.0-only OR BSD-2-Clause)
%YAML 1.2
---
$id: http://devicetree.org/schemas/sound/wm,wm8505-ac97.yaml#
$schema: http://devicetree.org/meta-schemas/core.yaml#

title: WonderMedia WM8505 AC97 Audio Controller

maintainers:
  - Logan Russell <me@lrussell.net>

properties:
  compatible:
    const: wm,wm8505-ac97

  reg:
    maxItems: 1

  interrupts:
    maxItems: 1

  clocks:
    maxItems: 1

  clock-names:
    items:
      - const: ac97

  dmas:
    items:
      - description: TX (playback) DMA channel
      - description: RX (capture) DMA channel

  dma-names:
    items:
      - const: tx
      - const: rx

  speaker-gpios:
    maxItems: 1
    description: GPIO for controlling the headphone/speaker amplifier

  wm,pinmux:
    $ref: /schemas/types.yaml#/definitions/phandle
    description:
      Phandle to the pinmux block whose global pin-sharing select routes
      the shared audio pins to AC97 or I2S

required:
  - compatible
  - reg
  - interrupts
  - clocks
  - clock-names
  - dmas
  - dma-names
  - wm,pinmux

additionalProperties: false

examples:
  - |
    #include <dt-bindings/clock/wm8505-clock.h>
    #include <dt-bindings/gpio/gpio.h>

    ac97@d8290000 {
        compatible = "wm,wm8505-ac97";
        reg = <0xd8290000 0x10000>;
        interrupts = <42>;
        clocks = <&pmc WM8505_CLK_AC97>;
        clock-names = "ac97";
        dmas = <&dmac 18>, <&dmac 19>;
        dma-names = "tx", "rx";
        speaker-gpios = <&pinctrl 3 GPIO_ACTIVE_LOW>;
        wm,pinmux = <&pinctrl>;
    };
```

## drivers/gpu/drm/wmt/Kconfig
```kconfig
# SPDX-License-Identifier: GPL-2.0-only
config DRM_WMT
	tristate "DRM Support for WonderMedia WM8505 SoCs"
	depends on DRM && OF && ARM
	select DRM_KMS_HELPER
	select DRM_GEM_DMA_HELPER
	select DRM_PANEL
	select DRM_PANEL_BRIDGE
	select VIDEOMODE_HELPERS
	help
	  Choose this option for DRM support for the WonderMedia WM8505 SoC.
	  This enables display output for the integrated LCD panel.
	  If M is selected, the modules will be called wmt-drm and wmt_panel.
	  If unsure, say N.
```
